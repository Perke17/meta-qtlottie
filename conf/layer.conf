## conf/layer.conf
```bitbake
# We have a conf and classes directory, add to BBPATH
BBPATH .= ":${LAYERDIR}"

# We have recipes-* directories, add to BBFILES
BBFILES += "${LAYERDIR}/recipes-*/*/*.bb \
            ${LAYERDIR}/recipes-*/*/*.bbappend"

BBFILE_COLLECTIONS += "meta-qtlottie"
BBFILE_PATTERN_meta-qtlottie = "^${LAYERDIR}/"
BBFILE_PRIORITY_meta-qtlottie = "6"

LAYERDEPENDS_meta-qtlottie = "core"
LAYERSERIES_COMPAT_meta-qtlottie = "thud warrior zeus"
```
